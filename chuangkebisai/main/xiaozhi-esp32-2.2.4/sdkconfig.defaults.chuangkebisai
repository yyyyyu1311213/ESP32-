## chuangkebisai/main/xiaozhi-esp32-2.2.4/sdkconfig.defaults.chuangkebisai
```kconfig
CONFIG_BOARD_TYPE_CHUANGKEBISAI_AUDIO=y
CONFIG_LANGUAGE_ZH_CN=y
CONFIG_FLASH_DEFAULT_ASSETS=y
CONFIG_USE_AUDIO_PROCESSOR=y
CONFIG_USE_AFE_WAKE_WORD=y
CONFIG_SEND_WAKE_WORD_DATA=y
CONFIG_USE_HOTSPOT_WIFI_PROVISIONING=y
CONFIG_ESPTOOLPY_FLASHSIZE_8MB=y
CONFIG_PARTITION_TABLE_CUSTOM_FILENAME="partitions/v2/8m.csv"
```
